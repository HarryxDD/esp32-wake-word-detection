## sdkconfig.defaults
```kconfig
# Disable color output (wrong output colors sometimes)
CONFIG_LOG_COLORS=n

# Config ESP32 CPU frequency
CONFIG_ESP_DEFAULT_CPU_FREQ_MHZ_240=y

# Config ESP32 Tool
CONFIG_ESPTOOLPY_FLASHFREQ_80M=y
CONFIG_ESPTOOLPY_FLASHMODE_QIO=y
CONFIG_ESPTOOLPY_FLASHSIZE_4MB=y

# Increase FreeRTOS clock frequency
CONFIG_FREERTOS_HZ=1000

# Disable task watchdog by default (suppress warnings in recognize)
# CPU0 - recognition loop (potential source of warnings)
# CPU1 - pulling data loop
CONFIG_ESP_TASK_WDT_EN=n

# Size optimizations
CONFIG_COMPILER_OPTIMIZATION_SIZE=y
CONFIG_COMPILER_OPTIMIZATION_ASSERTIONS_DISABLE=y
CONFIG_LOG_DEFAULT_LEVEL_INFO=y
CONFIG_LOG_MAXIMUM_LEVEL_INFO=y

# Disable unnecessary components
CONFIG_BT_ENABLED=n
CONFIG_BTDM_CTRL_BR_EDR_MAX_ACL_CONN_EFF=0
CONFIG_BTDM_CTRL_BLE_MAX_CONN_EFF=0
CONFIG_ESP_COREDUMP_ENABLE=n
CONFIG_ESP_ERR_TO_NAME_LOOKUP=n
CONFIG_LWIP_IPV6=n
CONFIG_ESP_EVENT_POST_FROM_ISR=n
CONFIG_ESP_EVENT_POST_FROM_IRAM_ISR=n
CONFIG_ESP_GDBSTUB_ENABLED=n

# Enable console UART output for debugging
CONFIG_ESP_CONSOLE_UART_DEFAULT=y
CONFIG_ESP_CONSOLE_UART_BAUDRATE_115200=y
CONFIG_ESP_CONSOLE_UART_NUM_0=y
CONFIG_ESP_CONSOLE_UART_TX_GPIO=1
CONFIG_ESP_CONSOLE_UART_RX_GPIO=3

# Disable unused protocols
CONFIG_LWIP_DHCP_DOES_ARP_CHECK=n
CONFIG_LWIP_DHCP_RESTORE_LAST_IP=n
CONFIG_LWIP_AUTOIP=n
CONFIG_LWIP_IGMP=n
CONFIG_LWIP_MULTICAST_PING=n
CONFIG_LWIP_BROADCAST_PING=n

# Disable debug features
CONFIG_ESP_SYSTEM_PANIC_PRINT_HALT=y
CONFIG_ESP_DEBUG_STUBS_ENABLE=n
CONFIG_ESP_DEBUG_OCDAWARE=n
```
